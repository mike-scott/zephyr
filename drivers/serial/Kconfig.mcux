## drivers/serial/Kconfig.mcux
```kconfig
# Kconfig - MCUXpresso SDK UART
#
# Copyright (c) 2017, NXP
#
# SPDX-License-Identifier: Apache-2.0
#

menuconfig UART_MCUX
	bool "MCUX uart driver"
	depends on HAS_MCUX && CLOCK_CONTROL
	select SERIAL_HAS_DRIVER
	select SERIAL_SUPPORT_INTERRUPT
	help
	  Enable the MCUX uart driver.

if UART_MCUX

menuconfig UART_MCUX_0
	bool "UART 0"
	help
	  Enable UART 0.

config UART_MCUX_0_FLOW_CONTROL
	bool "Enable HW Flow Control for UART 0"
	default n
	depends on UART_MCUX_0
	help
	  Enable HW Flow Control for UART 0. If selected, two addition pins
	  (RTS and CTS) need to be configured.

menuconfig UART_MCUX_1
	bool "UART 1"
	help
	  Enable UART 1.

config UART_MCUX_1_FLOW_CONTROL
	bool "Enable HW Flow Control for UART 1"
	default n
	depends on UART_MCUX_1
	help
	  Enable HW Flow Control for UART 1. If selected, two addition pins
	  (RTS and CTS) need to be configured.

menuconfig UART_MCUX_2
	bool "UART 2"
	help
	  Enable UART 2.

config UART_MCUX_2_FLOW_CONTROL
	bool "Enable HW Flow Control for UART 2"
	default n
	depends on UART_MCUX_2
	help
	  Enable HW Flow Control for UART 2. If selected, two addition pins
	  (RTS and CTS) need to be configured.

menuconfig UART_MCUX_3
	bool "UART 3"
	help
	  Enable UART 3.

config UART_MCUX_3_FLOW_CONTROL
	bool "Enable HW Flow Control for UART 3"
	default n
	depends on UART_MCUX_3
	help
	  Enable HW Flow Control for UART 3. If selected, two addition pins
	  (RTS and CTS) need to be configured.

menuconfig UART_MCUX_4
	bool "UART 4"
	help
	  Enable UART 4.

config UART_MCUX_4_FLOW_CONTROL
	bool "Enable HW Flow Control for UART 4"
	default n
	depends on UART_MCUX_4
	help
	  Enable HW Flow Control for UART 4. If selected, two addition pins
	  (RTS and CTS) need to be configured.

menuconfig UART_MCUX_5
	bool "UART 5"
	help
	  Enable UART 5.

config UART_MCUX_5_FLOW_CONTROL
	bool "Enable HW Flow Control for UART 5"
	default n
	depends on UART_MCUX_5
	help
	  Enable HW Flow Control for UART 5. If selected, two addition pins
	  (RTS and CTS) need to be configured.

endif # UART_MCUX
```

## dts/bindings/modem/wcn,m14a2a.yaml
```yaml
#
# Copyright (c) 2018, Open Source Foundries Limited.
#
# SPDX-License-Identifier: Apache-2.0
#
---
title: WCN-M14A2A LTE-M Modem
id: wcn,m14a2a
version: 0.1

description: >
    This is a representation of the WCN-M14A2A LTE-M modem.

inherits:
    !include uart-device.yaml

properties:
    compatible:
      type: string
      category: required
      constraint: "wcn,m14a2a"

    mdm-boot-mode-sel-gpios:
      type: compound
      category: required
      generation: define, use-prop-name

    mdm-power-gpios:
      type: compound
      category: required
      generation: define, use-prop-name

    mdm-keep-awake-gpios:
      type: compound
      category: required
      generation: define, use-prop-name

    mdm-reset-gpios:
      type: compound
      category: required
      generation: define, use-prop-name

    mdm-shld-trans-ena-gpios:
      type: compound
      category: required
      generation: define, use-prop-name

base_label: WCN14A2A
...
```

## dts/bindings/modem/wnc,m14a2a.yaml
```yaml
#
# Copyright (c) 2018, Open Source Foundries Limited.
#
# SPDX-License-Identifier: Apache-2.0
#
---
title: WNC-M14A2A LTE-M Modem
id: wnc,m14a2a
version: 0.1

description: >
    This is a representation of the WNC-M14A2A LTE-M modem.

inherits:
    !include uart-device.yaml

properties:
    compatible:
      type: string
      category: required
      constraint: "wnc,m14a2a"

    mdm-boot-mode-sel-gpios:
      type: compound
      category: required
      generation: define, use-prop-name

    mdm-power-gpios:
      type: compound
      category: required
      generation: define, use-prop-name

    mdm-keep-awake-gpios:
      type: compound
      category: required
      generation: define, use-prop-name

    mdm-reset-gpios:
      type: compound
      category: required
      generation: define, use-prop-name

    mdm-shld-trans-ena-gpios:
      type: compound
      category: required
      generation: define, use-prop-name

base_label: WNCM14A2A
...
```
